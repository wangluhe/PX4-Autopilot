## src/modules/Kconfig
```kconfig
rsource "*/Kconfig"

config MODULES_IMAGE_GUIDANCE
	bool "Image Guidance Module"
	depends on BOARD_PROTECTED

if MODULES_IMAGE_GUIDANCE
	source "image_guidance/Kconfig"
endif

endmenu
```

## src/modules/attack_vision/Kconfig
```kconfig
menuconfig MODULES_ATTACK_VISION
	bool "attack_vision"
	default n
	---help---
		Enable image terminal guidance (attack_vision) module

menuconfig USER_ATTACK_VISION
	bool "attack_vision running as userspace module"
	default n
	depends on BOARD_PROTECTED && MODULES_ATTACK_VISION
	---help---
		Put attack_vision in userspace memory
```

## src/modules/image_guidance/Kconfig
```kconfig
menuconfig MODULES_IMAGE_GUIDANCE
    bool "Image Guidance"
    default n
    ---help---
        Enable support for image-based guidance module

if MODULES_IMAGE_GUIDANCE

config IMAGE_GUIDANCE_UART
    string "UART Device Path"
    default "/dev/ttyS2"
    ---help---
        UART device path for communication with camera pod

config IMAGE_GUIDANCE_BAUDRATE
    int "UART Baudrate"
    default 115200
    ---help---
        Baudrate for UART communication

endif
```

## src/modules/vision_guidance/Kconfig
```kconfig
menuconfig MODULES_VISION_GUIDANCE
    bool "vision_guidance"
    default n
    ---help---
        Enable vision guidance module for target tracking and terminal guidance.
```
